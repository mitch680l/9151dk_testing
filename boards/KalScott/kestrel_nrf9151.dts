
/dts-v1/;
#include <nordic/nrf9151_laca.dtsi>
#include "kestrel_nrf9151_common.dts"

/ {
	chosen {
		zephyr,sram = &sram0;
		zephyr,flash = &flash0;
		zephyr,code-partition = &slot0_partition;

	};
};
