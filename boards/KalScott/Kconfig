## boards/KalScott/Kconfig
```kconfig
# Copyright (c) 2024 Nordic Semiconductor
# SPDX-License-Identifier: LicenseRef-Nordic-5-Clause

module=BOARD
module-dep=LOG
module-str=Log level for board
source "${ZEPHYR_BASE}/subsys/logging/Kconfig.template.log_config"

if BOARD_KESTREL_NRF5340_CPUAPP || BOARD_KESTREL_NRF5340_CPUAPP_NS

config BOARD_ENABLE_DCDC_APP
	bool "Application MCU DCDC converter"
	select SOC_DCDC_NRF53X_APP
	default y

config BOARD_ENABLE_DCDC_NET
	bool "Network MCU DCDC converter"
	select SOC_DCDC_NRF53X_NET
	default y

config DOMAIN_CPUNET_BOARD
	string
	default "kestrel/nrf5340/cpunet"
	depends on SOC_NRF53_CPUNET_ENABLE
	help
	  The board which will be used for CPUNET domain when creating a multi
	  image application where one or more images should be located on
	  another board. For example hci_rpmsg on the nRF5340_cpunet for
	  Bluetooth applications.

endif

if BOARD_KESTREL_NRF5340_CPUNET

config BT_ECC
	default y if BT

config DOMAIN_CPUAPP_BOARD
	string
	default "kestrel/nrf5340/cpuapp"
	help
	  The board which will be used for CPUAPP domain when creating a multi
	  image application where one or more images should be located on
	  another board.

endif # BOARD_KESTREL_NRF5340_CPUNET

# Board-level configuration for SPI Bus Share module
config KESTREL_SPI_BUS_SHARE
	bool "Enable SPI Bus Share Module"
	default y
	help
	  Enable the SPI bus share module for both MCUboot and application.

	  When enabled:
	  - MCUboot will compile spi_bus_init.c and spi_bus_share.c with
	    BOOT_IMAGE_ACCESS_HOOKS support
	  - Application will compile spi_bus_share.c for runtime bus arbitration

	  When disabled:
	  - Both MCUboot and application will NOT include SPI bus sharing code
	  - Reduces code size in both images
	  - Use this if you don't need SPI bus arbitration at all

	  If unsure, say Y.

# Include SPI Bus Share module Kconfig
rsource "spi_bus_share/Kconfig"
```

## boards/KalScott/Kconfig.kestrel
```kconfig
# Copyright (c) 2024 Nordic Semiconductor
# SPDX-License-Identifier: LicenseRef-Nordic-5-Clause

config BOARD_KESTREL
	select SOC_NRF9151_LACA if BOARD_KESTREL_NRF9151 || BOARD_KESTREL_NRF9151_NS
	select SOC_NRF5340_CPUNET_QKAA if BOARD_KESTREL_NRF5340_CPUNET
	select SOC_NRF5340_CPUAPP_QKAA if BOARD_KESTREL_NRF5340_CPUAPP || BOARD_KESTREL_NRF5340_CPUAPP_NS
```

## boards/KalScott/Kconfig.sysbuild
```kconfig
# Copyright (c) 2024 Nordic Semiconductor ASA
# SPDX-License-Identifier: LicenseRef-Nordic-5-Clause

choice BOOTLOADER
	default BOOTLOADER_MCUBOOT if KESTREL_STATIC_PARTITIONS_FACTORY || KESTREL_STATIC_PARTITIONS_NRF53_EXTERNAL_FLASH
endchoice

choice
	prompt "Pre-defined Kestrel partition layout"
	default KESTREL_STATIC_PARTITIONS_NRF53_EXTERNAL_FLASH if SOC_SERIES_NRF53X
	default KESTREL_STATIC_PARTITIONS_FACTORY

config KESTREL_STATIC_PARTITIONS_FACTORY
	bool "Factory Thingy:91 X partition layout"
	help
	   The default Thingy:91 X partition layout used in the factory firmware. This ensures
	   firmware updates are compatible with Thingy:91 X when flashing firmware over USB or over
	   the air.

config KESTREL_STATIC_PARTITIONS_NRF53_EXTERNAL_FLASH
	bool "External flash Thingy:91 X partition layout"
	depends on SOC_SERIES_NRF53X
	help
	   The Thingy:91 X partition layout used when the nRF53 owns the external flash.

config KESTREL_NO_PREDEFINED_LAYOUT
	bool "None [EXPERIMENTAL]"
	select EXPERIMENTAL
	help
	   Disable pre-defined static partition layout. This allows the application to use a dynamic
	   layout or define a custom static partition layout for the application. A debugger is
	   needed to flash Thingy:91 with a different partition layout.

endchoice

if BOARD_KESTREL_NRF5340_CPUAPP || BOARD_KESTREL_NRF5340_CPUAPP_NS

config SECURE_BOOT_NETCORE
	default y if BOOTLOADER_MCUBOOT

config SECURE_BOOT_APPCORE
	default y if BOOTLOADER_MCUBOOT

config NETCORE_APP_UPDATE
	default n

config NRF_DEFAULT_EMPTY
	default n

endif # BOARD_KESTREL_NRF5340_CPUAPP || BOARD_KESTREL_NRF5340_CPUAPP_NS

if BOARD_KESTREL_NRF5340_CPUAPP || BOARD_KESTREL_NRF5340_CPUAPP_NS || BOARD_KESTREL_NRF5340_CPUNET

# Do not use these keys for own custom boards!
# These are meant as examples and therefore public.
# The documentation of the nRF Secure Immutable Bootloader and MCUBoot detail on how
# to set up your own keys.

config SECURE_BOOT_SIGNING_KEY_FILE
	default "$(ZEPHYR_NRF_MODULE_DIR)/boards/nordic/thingy91x/nsib_signing_key_nrf5340.pem"

endif # BOARD_KESTREL_NRF5340_CPUAPP || BOARD_KESTREL_NRF5340_CPUAPP_NS || BOARD_KESTREL_NRF5340_CPUNET

if BOARD_KESTREL_NRF9151 || BOARD_KESTREL_NRF9151_NS

config SECURE_BOOT_APPCORE
	default y if KESTREL_STATIC_PARTITIONS_FACTORY

config PM_EXTERNAL_FLASH_MCUBOOT_SECONDARY
	default y if BOOTLOADER_MCUBOOT

config PM_OVERRIDE_EXTERNAL_DRIVER_CHECK
	default y if BOOTLOADER_MCUBOOT

config SECURE_BOOT_SIGNING_KEY_FILE
	default "$(ZEPHYR_NRF_MODULE_DIR)/boards/nordic/thingy91x/nsib_signing_key.pem"

endif # BOARD_KESTREL_NRF9151 || BOARD_KESTREL_NRF9151_NS

if KESTREL_STATIC_PARTITIONS_NRF53_EXTERNAL_FLASH

config PM_EXTERNAL_FLASH_MCUBOOT_SECONDARY
	default y if BOOTLOADER_MCUBOOT

config PM_OVERRIDE_EXTERNAL_DRIVER_CHECK
	default y if BOOTLOADER_MCUBOOT

endif
```

## boards/KalScott/board.yml
```yaml
board:
  name: kestrel
  vendor: nordic
  socs:
    - name: nrf9151
      variants:
        - name: ns
    - name: nrf5340
      variants:
        - name: ns
          cpucluster: 'cpuapp'
```

## boards/KalScott/kestrel_nrf9151_defconfig
```kconfig
CONFIG_ARM_TRUSTZONE_M=y


CONFIG_PINCTRL=y


CONFIG_GPIO=y


CONFIG_SERIAL=y

CONFIG_UART_CONSOLE=y


CONFIG_ENTROPY_NRF5_RNG=n
```

## boards/KalScott/kestrel_nrf9151_ns_defconfig
```kconfig
CONFIG_ARM_MPU=y

CONFIG_ARM_TRUSTZONE_M=y

CONFIG_TRUSTED_EXECUTION_NONSECURE=y

CONFIG_PINCTRL=y


CONFIG_GPIO=y


CONFIG_SERIAL=y


CONFIG_CONSOLE=y
CONFIG_UART_CONSOLE=y


CONFIG_I2C=y


CONFIG_SPI=y


CONFIG_FLASH=y
CONFIG_SPI_NOR=y
CONFIG_SPI_NOR_SFDP_DEVICETREE=y
CONFIG_SPI_NOR_FLASH_LAYOUT_PAGE_SIZE=4096
CONFIG_PM_DEVICE_RUNTIME=y


CONFIG_SENSOR=y


CONFIG_ENTROPY_NRF5_RNG=n
```

## boards/KalScott/spi_bus_share/Kconfig
```kconfig
# SPI Bus Share Module Configuration

menuconfig SPI_BUS_SHARE
	bool "SPI Bus Sharing Support"
	depends on SPI || NORDIC_QSPI_NOR
	depends on KESTREL_SPI_BUS_SHARE
	default y if KESTREL_SPI_BUS_SHARE
	help
	  Enable SPI/QSPI bus sharing/arbitration support for managing access
	  to a shared bus between multiple components (e.g., external
	  flash and other SPI/QSPI devices).

	  This option is controlled by the board-level KESTREL_SPI_BUS_SHARE
	  setting and affects both MCUboot and application builds.

if SPI_BUS_SHARE

config SPI_BUS_SHARE_BOOTLOADER
	bool "SPI Bus Share in Bootloader context"
	default n
	help
	  Enable this when the SPI bus share module is being used in a
	  bootloader context (MCUboot). This affects initialization timing
	  and available features. Requires CONFIG_BOOT_GO_HOOKS.

config SPI_BUS_SHARE_SHELL
	bool "SPI Bus Share Shell Commands"
	depends on SHELL
	help
	  Enable shell commands for debugging and testing SPI bus sharing.
	  Provides commands to inspect bus state, manually request/release
	  the bus, and view statistics.

config SPI_BUS_SHARE_NRF9151
	bool
	default y if SOC_NRF9151_LACA || SOC_NRF9120 || SOC_NRF9160
	help
	  Automatically enabled for nRF9151/nRF9120/nRF9160 SoCs.

config SPI_BUS_SHARE_NRF5340
	bool
	default y if SOC_NRF5340_CPUAPP || SOC_NRF5340_CPUNET
	help
	  Automatically enabled for nRF5340 SoC.

config SPI_BUS_SHARE_DETERM
	bool "Deterministic Arbitration"
	default y
	help
	 Use deterministic model of arbitration. i.e. always a mcu owns spi bus

endif # SPI_BUS_SHARE
```
