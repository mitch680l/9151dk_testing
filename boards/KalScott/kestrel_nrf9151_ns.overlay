&i2c1 {
	status = "disabled";
	clock-frequency = <I2C_BITRATE_STANDARD>;
};

&i2c2 {
	status = "okay";
	clock-frequency = <I2C_BITRATE_STANDARD>;
    zephyr,concat-buf-size = <64>;
    zephyr,flash-buf-max-size = <64>;
};

&ext_flash {
    status = "okay";
};

&spi3 {
	status = "okay";
};

